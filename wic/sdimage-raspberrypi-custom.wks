## wic/sdimage-raspberrypi-custom.wks
```
#  Custom Raspberry Pi SD card image with vgat Boot files, root, root-backup and data partitions

part /boot --source bootimg-partition --ondisk mmcblk0 --fstype=vfat --label boot --active --align 4096 --fixed-size 100
part / --source rootfs --ondisk mmcblk0 --fstype=ext4 --label root --align 4096 --fixed-size 800
part / --ondisk mmcblk0 --fstype=ext4 --label root-backup --align 4096 --fixed-size 800
part /data --ondisk mmcblk0 --fstype=ext4 --label data --align 4096 --fixed-size 1024
```
